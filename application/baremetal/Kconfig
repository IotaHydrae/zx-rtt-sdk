## application/baremetal/Kconfig
```kconfig
menu "Baremetal APP options"

config PRJ_APP
    string "Application name"
	default "baremetal"

source "application/baremetal/bootloader/Kconfig"
source "application/baremetal/helloworld/Kconfig"

endmenu
```

## application/baremetal/helloworld/Kconfig
```kconfig
menuconfig BAREMETAL_HELLOWORLD
    tristate "BAREMETAL_HELLOWORLD"
    default n
```

## application/freertos/Kconfig
```kconfig
menu "Application options"

config PRJ_APP
    string "Application name"
	default "os"

#============================================
# Filesystem related:
#============================================

comment "Filesystem related"

menuconfig AIC_USING_FS_IMAGE_0
    bool "Using File System Image 0"
    default n
    depends on KERNEL_RTTHREAD

if AIC_USING_FS_IMAGE_0
choice
    prompt "Select File System Type"
    default AIC_USING_FS_IMAGE_TYPE_LITTLEFS_FOR_0
    config AIC_USING_FS_IMAGE_TYPE_FATFS_FOR_0
        bool "FATFS"
    config AIC_USING_FS_IMAGE_TYPE_UFFS_FOR_0
        bool "UFFS"
    config AIC_USING_FS_IMAGE_TYPE_LITTLEFS_FOR_0
        bool "LittleFS"
endchoice

config AIC_FS_IMAGE_DIR_0
    string "Data Directory"
    default ""

config AIC_FS_IMAGE_NAME_0
    string "Image Name"
    default "app.lfs"

if AIC_USING_FS_IMAGE_TYPE_FATFS_FOR_0
config AIC_FATFS_AUTO_SIZE_FOR_0
    bool "auto calcuate image size"
    default y
config AIC_FATFS_SECTOR_SIZE_FOR_0
    int "sector size"
    depends on !AIC_FATFS_AUTO_SIZE_FOR_0
    default 512

config AIC_FATFS_SECTOR_COUNT_FOR_0
    int "sector count"
    depends on !AIC_FATFS_AUTO_SIZE_FOR_0
    default 2048
endif

# Parameters for LittleFS
if AIC_USING_FS_IMAGE_TYPE_LITTLEFS_FOR_0
config AIC_LITTLEFS_BLOCK_SIZE_FOR_0
    int "Erase block size"
    default 4096
config AIC_LITTLEFS_PAGE_SIZE_FOR_0
    int "Page size"
    default 256
endif

endif

menuconfig AIC_USING_FS_IMAGE_1
    bool "Using File System Image 1"
    default n
    depends on KERNEL_RTTHREAD

if AIC_USING_FS_IMAGE_1
choice
    prompt "Select File System Type"
    default AIC_USING_FS_IMAGE_TYPE_LITTLEFS_FOR_1
    config AIC_USING_FS_IMAGE_TYPE_FATFS_FOR_1
        bool "FATFS"
    config AIC_USING_FS_IMAGE_TYPE_UFFS_FOR_1
        bool "UFFS"
    config AIC_USING_FS_IMAGE_TYPE_LITTLEFS_FOR_1
        bool "LittleFS"
endchoice

config AIC_FS_IMAGE_DIR_1
    string "Data Directory"
    default "fs_user"

config AIC_FS_IMAGE_NAME_1
    string "Image Name"
    default "user"

if AIC_USING_FS_IMAGE_TYPE_FATFS_FOR_1
config AIC_FATFS_AUTO_SIZE_FOR_1
    bool "auto calcuate image size"
    default y
config AIC_FATFS_SECTOR_SIZE_FOR_1
    int "sector size"
    depends on !AIC_FATFS_AUTO_SIZE_FOR_1
    default 512

config AIC_FATFS_SECTOR_COUNT_FOR_1
    int "sector count"
    depends on !AIC_FATFS_AUTO_SIZE_FOR_1
    default 2048
endif

# Parameters for LittleFS
if AIC_USING_FS_IMAGE_TYPE_LITTLEFS_FOR_1
config AIC_LITTLEFS_BLOCK_SIZE_FOR_1
    int "Erase block size"
    default 4096
config AIC_LITTLEFS_PAGE_SIZE_FOR_1
    int "Page size"
    default 256
endif

endif

if AIC_USING_FS_IMAGE_TYPE_FATFS_FOR_0 || AIC_USING_FS_IMAGE_TYPE_FATFS_FOR_1
    config AIC_USING_FS_IMAGE_TYPE_FATFS_CLUSTER_SIZE
        int "size of cluster in fatfs image"
        default 8
endif

source "application/freertos/benchmark/Kconfig"

endmenu
```

## application/freertos/benchmark/Kconfig
```kconfig
menuconfig ZX_LVGL_BENCHMARK_DEMO
    tristate "ZX lvgl benchmark demo"
    select LPKG_USING_LVGL
    default n
menuconfig ZX_LVGL_MJPEG_DECODE_DEMO
    depends on ZX_LVGL_BENCHMARK_DEMO
    tristate "ZX lvgl mjpeg demo"
    default n
```

## application/os/Kconfig
```kconfig
menu "Application options"

config PRJ_APP
    string "Application name"
	default "os"

#============================================
# Filesystem related:
#============================================

comment "Filesystem related"

menuconfig AIC_USING_FS_IMAGE_0
    bool "Using File System Image 0"
    default n
    depends on KERNEL_RTTHREAD

if AIC_USING_FS_IMAGE_0
choice
    prompt "Select File System Type"
    default AIC_USING_FS_IMAGE_TYPE_LITTLEFS_FOR_0
    config AIC_USING_FS_IMAGE_TYPE_FATFS_FOR_0
        bool "FATFS"
    config AIC_USING_FS_IMAGE_TYPE_UFFS_FOR_0
        bool "UFFS"
    config AIC_USING_FS_IMAGE_TYPE_LITTLEFS_FOR_0
        bool "LittleFS"
endchoice

config AIC_FS_IMAGE_DIR_0
    string "Data Directory"
    default ""

config AIC_FS_IMAGE_NAME_0
    string "Image Name"
    default "app.lfs"

if AIC_USING_FS_IMAGE_TYPE_FATFS_FOR_0
config AIC_FATFS_AUTO_SIZE_FOR_0
    bool "auto calcuate image size"
    default y
config AIC_FATFS_SECTOR_SIZE_FOR_0
    int "sector size"
    depends on !AIC_FATFS_AUTO_SIZE_FOR_0
    default 512

config AIC_FATFS_SECTOR_COUNT_FOR_0
    int "sector count"
    depends on !AIC_FATFS_AUTO_SIZE_FOR_0
    default 2048
endif

# Parameters for LittleFS
if AIC_USING_FS_IMAGE_TYPE_LITTLEFS_FOR_0
config AIC_LITTLEFS_BLOCK_SIZE_FOR_0
    int "Erase block size"
    default 4096
config AIC_LITTLEFS_PAGE_SIZE_FOR_0
    int "Page size"
    default 256
endif

endif

menuconfig AIC_USING_FS_IMAGE_1
    bool "Using File System Image 1"
    default n
    depends on KERNEL_RTTHREAD

if AIC_USING_FS_IMAGE_1
choice
    prompt "Select File System Type"
    default AIC_USING_FS_IMAGE_TYPE_LITTLEFS_FOR_1
    config AIC_USING_FS_IMAGE_TYPE_FATFS_FOR_1
        bool "FATFS"
    config AIC_USING_FS_IMAGE_TYPE_UFFS_FOR_1
        bool "UFFS"
    config AIC_USING_FS_IMAGE_TYPE_LITTLEFS_FOR_1
        bool "LittleFS"
endchoice

config AIC_FS_IMAGE_DIR_1
    string "Data Directory"
    default "fs_user"

config AIC_FS_IMAGE_NAME_1
    string "Image Name"
    default "user"

if AIC_USING_FS_IMAGE_TYPE_FATFS_FOR_1
config AIC_FATFS_AUTO_SIZE_FOR_1
    bool "auto calcuate image size"
    default y
config AIC_FATFS_SECTOR_SIZE_FOR_1
    int "sector size"
    depends on !AIC_FATFS_AUTO_SIZE_FOR_1
    default 512

config AIC_FATFS_SECTOR_COUNT_FOR_1
    int "sector count"
    depends on !AIC_FATFS_AUTO_SIZE_FOR_1
    default 2048
endif

# Parameters for LittleFS
if AIC_USING_FS_IMAGE_TYPE_LITTLEFS_FOR_1
config AIC_LITTLEFS_BLOCK_SIZE_FOR_1
    int "Erase block size"
    default 4096
config AIC_LITTLEFS_PAGE_SIZE_FOR_1
    int "Page size"
    default 256
endif

endif

if AIC_USING_FS_IMAGE_TYPE_FATFS_FOR_0 || AIC_USING_FS_IMAGE_TYPE_FATFS_FOR_1
    config AIC_USING_FS_IMAGE_TYPE_FATFS_CLUSTER_SIZE
        int "size of cluster in fatfs image"
        default 8
endif
config GENERATE_BURNER_IMAGE
    bool "Generate burner format image"
    default n

source "application/os/benchmark/Kconfig"
source "application/os/freetype/Kconfig"
source "application/os/ZX3D95/Kconfig"
source "application/os/custdemo/Kconfig"
source "application/os/widgets/Kconfig"
source "application/os/jpegplayer/Kconfig"
source "application/os/meter_demo/Kconfig"
source "application/os/base_demo/Kconfig"
source "application/os/wft_longxin/Kconfig"
source "application/os/m3a7d0_demo/Kconfig"
source "application/os/m3c3d10_demo/Kconfig"
source "application/os/ZX_M3E_4D3_demo/Kconfig"

source "application/os/de_cache/Kconfig"


endmenu
```

## application/os/ZX3D95/Kconfig
```kconfig
menuconfig ZX3D95_DEMO
    tristate "ZX 3D95 demo"
    select LPKG_USING_LVGL
    default n
```

## application/os/ZX_M3E_4D3_demo/Kconfig
```kconfig
menuconfig ZX_M3E_4D3_DEMO
    tristate "ZX M3E 4D3 demo"
    select LPKG_USING_LVGL
    default n
```

## application/os/base_demo/Kconfig
```kconfig
menuconfig ZX_BASE_DEMO
    tristate "ZX BASE demo"
    select LPKG_USING_LVGL
    default n
```

## application/os/custdemo/Kconfig
```kconfig
menuconfig ZX_CUSTDEMO
    tristate "ZX CUST demo"
    select LPKG_USING_LVGL
    default n
```

## application/os/de_cache/Kconfig
```kconfig
menuconfig ZX_DE_CACHE_DEMO
    tristate "ZX de_cache demo"
    select LPKG_USING_LVGL
    default n
```

## application/os/freetype/Kconfig
```kconfig
menuconfig ZX_FREETYPE_DEMO
    tristate "ZX freetype demo"
    select LPKG_USING_LVGL
    select LPKG_USING_FREETYPE
    default n
```

## application/os/jpegplayer/Kconfig
```kconfig
menuconfig JPEGPLAYER_DEMO
    tristate "ZX jpeg demo"
    select LPKG_USING_LVGL
    default n
```

## application/os/m3a7d0_demo/Kconfig
```kconfig
menuconfig ZXM3A7D0_DEMO
    tristate "ZX M3A7D0 demo"
    select LPKG_USING_LVGL
    default n
```

## application/os/m3c3d10_demo/Kconfig
```kconfig
menuconfig ZXM3C3D10_DEMO
    tristate "ZX M3C3D10 demo"
    select LPKG_USING_LVGL
    default n
```

## application/os/meter_demo/Kconfig
```kconfig
menuconfig ZX_METER_DEMO
    tristate "ZX METER demo"
    select LPKG_USING_LVGL
    default n
```

## application/os/wft_longxin/Kconfig
```kconfig
menuconfig WFT_LONGXIN
    tristate "wft_longxin"
    select LPKG_USING_LVGL
    select LPKG_USING_FREETYPE
    default n
```

## application/os/widgets/Kconfig
```kconfig
menuconfig ZX_WIDGETS_DEMO
    tristate "ZX lvgl widgets demo"
    select LPKG_USING_LVGL
    default n
```

## bsp/peripheral/Kconfig
```kconfig
source "bsp/peripheral/spinand/Kconfig"
source "bsp/peripheral/spinor_sfud/Kconfig"
source "bsp/peripheral/nftl/Kconfig"

#--------------------------------------------
# touch panel driver global option
#--------------------------------------------

menu "Touch Panel Support"
if KERNEL_RTTHREAD
source "bsp/peripheral/touch/Kconfig"
source "bsp/peripheral/touch/rtp/Kconfig"
endif
if KERNEL_FREERTOS
source "bsp/peripheral/touch_freertos/Kconfig"
endif
endmenu

#--------------------------------------------
# Audio Codec driver option
#--------------------------------------------

menu "External Audio Codec Support"
source "bsp/peripheral/codec/Kconfig"
endmenu
```

## bsp/peripheral/touch/Kconfig
```kconfig
menu "touch panel options"

choice
    prompt "select touch panel"
    default ZX_TOUCH_NONE

config ZX_TOUCH_NONE
    bool "none touch"

config ZX_TOUCH_GT911
    bool "gt911 touch"
    select AIC_I2C_DRV

config ZX_TOUCH_ILITEK
    bool "ilitek touch"
    select AIC_I2C_DRV

config ZX_TOUCH_CST226SE
    bool "cst226se touch"
    select AIC_I2C_DRV

config ZX_TOUCH_CST3240
    bool "cst3240 touch"
    select AIC_I2C_DRV

config ZX_TOUCH_FT5X06
    bool "ft5x06 touch"
    select AIC_I2C_DRV

config ZX_TOUCH_FT7411
    bool "ft7411 touch"
    select AIC_I2C_DRV

config ZX_TOUCH_GSL1680
    bool "gsl1680 touch"
    select AIC_I2C_DRV

config ZX_TOUCH_GSL2036
    bool "gsl2036 touch"
    select AIC_I2C_DRV

endchoice

if ZX_TOUCH_GT911
source "bsp/peripheral/touch/gt911/Kconfig"
endif

if ZX_TOUCH_ILITEK
source "bsp/peripheral/touch/ilitek/Kconfig"
endif

if ZX_TOUCH_CST226SE
source "bsp/peripheral/touch/cst226se/Kconfig"
endif

if ZX_TOUCH_CST3240
    source "bsp/peripheral/touch/cst3240/Kconfig"
    endif

if ZX_TOUCH_FT5X06
source "bsp/peripheral/touch/ft5x06/Kconfig"
endif

if ZX_TOUCH_FT7411
source "bsp/peripheral/touch/ft7411/Kconfig"
endif

if ZX_TOUCH_GSL1680
source "bsp/peripheral/touch/gsl1680/Kconfig"
endif

if ZX_TOUCH_GSL2036
source "bsp/peripheral/touch/gsl2036/Kconfig"
endif

endmenu
```

## bsp/peripheral/touch/cst226se/Kconfig
```kconfig
menu "CST226SE touch panel options"

config ZX_TOUCH_PANEL_NAME
    string "touch name"
    default "cst226se"
    depends on ZX_TOUCH_CST226SE

config QSMD_TOUCH_CST226SE_I2C_CHA
    string "CST226SE using i2c channel index"
    default "i2c3"
    depends on ZX_TOUCH_CST226SE

config QSMD_TOUCH_CST226SE_RST_PIN
    string "CST226SE reset pin"
    default "PA.8"
    depends on ZX_TOUCH_CST226SE

config QSMD_TOUCH_CST226SE_INT_PIN
    string "CST226SE irq pin"
    default "PA.9"
    depends on ZX_TOUCH_CST226SE

endmenu
```

## bsp/peripheral/touch/cst3240/Kconfig
```kconfig
menu "CST3240 touch panel options"

config ZX_TOUCH_PANEL_NAME
    string "touch name"
    default "cst3240"
    depends on ZX_TOUCH_CST3240

config QSMD_TOUCH_CST3240_I2C_CHA
    string "CST3240 using i2c channel index"
    default "i2c1"
    depends on ZX_TOUCH_CST3240

config QSMD_TOUCH_CST3240_RST_PIN
    string "CST3240 reset pin"
    default "PC.2"
    depends on ZX_TOUCH_CST3240

config QSMD_TOUCH_CST3240_INT_PIN
    string "CST3240 irq pin"
    default "PC.3"
    depends on ZX_TOUCH_CST3240

endmenu
```

## bsp/peripheral/touch/ft5x06/Kconfig
```kconfig
menu "FT5X06 touch panel options"

config ZX_TOUCH_PANEL_NAME
    string "ft5x06 name"
    default "ft5x06"
    depends on ZX_TOUCH_FT5X06

config ZX_TOUCH_PANEL_FT5X06_I2C_CHA
    string "ft5x06 using i2c channel index"
    default "i2c3"
    depends on ZX_TOUCH_FT5X06

config ZX_TOUCH_PANEL_FT5X06_RST_PIN
    string "ft5x06 reset pin"
    default "PA.8"
    depends on ZX_TOUCH_FT5X06

config ZX_TOUCH_PANEL_FT5X06_INT_PIN
    string "ft5x06 irq pin"
    default "PA.9"
    depends on ZX_TOUCH_FT5X06

endmenu
```

## bsp/peripheral/touch/ft7411/Kconfig
```kconfig
menu "Ft7411 touch panel options"

config ZX_TOUCH_PANEL_FT7411
    bool "Using touch panel ft7411"
    default n
    depends on ZX_TOUCH_FT7411

config ZX_TOUCH_PANEL_FT7411_I2C_CHA
    string "ft7411 using i2c channel index"
    default "i2c3"
    depends on ZX_TOUCH_PANEL_FT7411

config ZX_TOUCH_PANEL_FT7411_RST_PIN
    string "ft7411 reset pin"
    default "PA.8"
    depends on ZX_TOUCH_PANEL_FT7411

config ZX_TOUCH_PANEL_FT7411_INT_PIN
    string "ft7411 irq pin"
    default "PA.9"
    depends on ZX_TOUCH_PANEL_FT7411

config ZX_TOUCH_PANEL_FT7411_X_RANGE
    int "ft7411 x coordinate range"
    default 480
    depends on ZX_TOUCH_PANEL_FT7411

config ZX_TOUCH_PANEL_FT7411_Y_RANGE
    int "ft7411 y coordinate range"
    default 800
    depends on ZX_TOUCH_PANEL_FT7411

endmenu
```

## bsp/peripheral/touch/gsl1680/Kconfig
```kconfig
menu "GSL1680 touch panel options"

config ZX_TOUCH_PANEL_GSL1680
    bool "Using touch panel gsl1680"
    default n
    depends on ZX_TOUCH_GSL1680

config ZX_TOUCH_PANEL_GSL1680_I2C_CHA
    string "gsl1680 using i2c channel index"
    default "i2c2"
    depends on ZX_TOUCH_PANEL_GSL1680

config ZX_TOUCH_PANEL_GSL1680_RST_PIN
    string "gsl1680 reset pin"
    default "PA.10"
    depends on ZX_TOUCH_PANEL_GSL1680

config ZX_TOUCH_PANEL_GSL1680_INT_PIN
    string "gsl1680 irq pin"
    default "PA.11"
    depends on ZX_TOUCH_PANEL_GSL1680

config ZX_TOUCH_PANEL_GSL1680_X_RANGE
    int "gsl1680 x coordinate range"
    default 480
    depends on ZX_TOUCH_PANEL_GSL1680

config ZX_TOUCH_PANEL_GSL1680_Y_RANGE
    int "gsl1680 y coordinate range"
    default 272
    depends on ZX_TOUCH_PANEL_GSL1680

endmenu
```

## bsp/peripheral/touch/gsl2036/Kconfig
```kconfig
menu "GSL2036 touch panel options"

config ZX_TOUCH_PANEL_NAME
    string "gsl2036 name"
    default "gsl2036"
    depends on ZX_TOUCH_GSL2036

config ZX_TOUCH_PANEL_GSL2036_I2C_CHA
    string "gsl2036 using i2c channel index"
    default "i2c2"
    depends on ZX_TOUCH_GSL2036

config ZX_TOUCH_PANEL_GSL2036_RST_PIN
    string "gsl2036 reset pin"
    default "PA.10"
    depends on ZX_TOUCH_GSL2036

config ZX_TOUCH_PANEL_GSL2036_INT_PIN
    string "gsl2036 irq pin"
    default "PA.11"
    depends on ZX_TOUCH_GSL2036

config ZX_TOUCH_PANEL_GSL2036_X_RANGE
    int "gsl2036 x coordinate range"
    default 480
    depends on ZX_TOUCH_GSL2036

config ZX_TOUCH_PANEL_GSL2036_Y_RANGE
    int "gsl2036 y coordinate range"
    default 272
    depends on ZX_TOUCH_GSL2036

endmenu
```
