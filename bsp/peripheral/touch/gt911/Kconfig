## bsp/peripheral/touch/gt911/Kconfig
```kconfig
menu "Gt911 touch panel options"

config ZX_TOUCH_PANEL_NAME
    string "gt911 name"
    default "gt911"
    depends on ZX_TOUCH_GT911

config AIC_TOUCH_PANEL_GT911_I2C_CHA
    string "gt911 using i2c channel index"
    default "i2c3"
    depends on ZX_TOUCH_GT911

config AIC_TOUCH_PANEL_GT911_RST_PIN
    string "gt911 reset pin"
    default "PA.8"
    depends on ZX_TOUCH_GT911

config AIC_TOUCH_PANEL_GT911_INT_PIN
    string "gt911 irq pin"
    default "PA.9"
    depends on ZX_TOUCH_GT911

endmenu
```

## bsp/peripheral/touch/ilitek/Kconfig
```kconfig
menu "Ilitek touch panel options"

config ZX_TOUCH_PANEL_NAME
    string "touch name"
    default "ilitek"
    depends on ZX_TOUCH_ILITEK

config QSMD_TOUCH_ILITEK_I2C_CHA
    string "Ilitek using i2c channel index"
    default "i2c3"
    depends on ZX_TOUCH_ILITEK

config QSMD_TOUCH_ILITEK_RST_PIN
    string "Ilitek reset pin"
    default "PA.8"
    depends on ZX_TOUCH_ILITEK

config QSMD_TOUCH_ILITEK_INT_PIN
    string "Ilitek irq pin"
    default "PA.9"
    depends on ZX_TOUCH_ILITEK

endmenu
```

## bsp/peripheral/touch_freertos/Kconfig
```kconfig
config TOUCH_PANEL_DRIVER
    tristate "Enable Touch Panel Support"
    default n
    help
      Enable support for touch panel drivers.

config ZX_TOUCH_NONE
    bool
    default y

if TOUCH_PANEL_DRIVER
config TOUCH_PANEL_DRIVER
    bool
    default y

choice
    prompt "Select Touch Panel Driver"
    default TOUCH_DRIVER_GT911
config TOUCH_DRIVER_FT5X06
    bool "FT5X06"
    help
      Select this option to use the FT5X06 touch panel driver.

config TOUCH_DRIVER_GT2863
    bool "GT2863"
    help
      Select this option to use the GT2863 touch panel driver.

config TOUCH_DRIVER_CST816T
    bool "CST816T"
    help
      Select this option to use the CST816T touch panel driver.

config TOUCH_DRIVER_GT911
    bool "GT911"
    help
      Select this option to use the GT911 touch panel driver.

config TOUCH_DRIVER_CHSC6540
    bool "CHSC6540"
    help
      Select this option to use the CHSC6540 touch panel driver.

config TOUCH_DRIVER_SP2010
    bool "SP2010"
    help
      Select this option to use the SP2010 touch panel driver.

config TOUCH_DRIVER_CST328
    bool "CST328"
    help
      Select this option to use the CST328 touch panel driver.

endchoice

config TOUCH_PANEL_WIDTH
    int "Touch Panel Width"
    default 1024
    help
      Specify the width of the touch panel in pixels.

config TOUCH_PANEL_HEIGHT
    int "Touch Panel Height"
    default 600
    help
      Specify the height of the touch panel in pixels.

choice
    prompt "Touch Panel Direction"
    default TOUCH_PANEL_DIRECTION_0
    help
      Specify the rotation of the touch panel. Options are 0 degrees, 90 degrees, 180 degrees, and 270 degrees.

config TOUCH_PANEL_DIRECTION_0
    bool "0 degrees"

config TOUCH_PANEL_DIRECTION_90
    bool "90 degrees"

config TOUCH_PANEL_DIRECTION_180
    bool "180 degrees"

config TOUCH_PANEL_DIRECTION_270
    bool "270 degrees"

endchoice

config TOUCH_PANEL_RST_PIN
    string "Reset Pin"
    default "PD.15"
    help
      Specify the Reset pin for the touch panel, e.g., "PA.2".

config TOUCH_PANEL_INTR_PIN
    string "Interrupt Pin"
    default "PD.14"
    help
      Specify the Interrupt pin for the touch panel. Leave blank if not used.

config TOUCH_PANEL_I2C_NUM
    int "I2C Number"
    default 0
    help
      Specify the I2C controller number the touch panel is connected to.

config TOUCH_PANEL_I2C_FREQ
    int "I2C Frequency"
    default 400000
    help
      Specify the I2C frequency in Hz.

endif # TOUCH_PANEL_DRIVER
```

## bsp/zx/drv/display/Kconfig.mipi
```kconfig
#-----------------------------
# mipi devices local parameter
#-----------------------------

menu "MIPI interface options"
    depends on AIC_DISP_MIPI_DSI_DRV

config AIC_MIPI_LANE_ASSIGNMENTS
    hex "MIPI lane assigments"
    default 0x3210
    depends on AIC_DISP_MIPI_DSI_DRV

config AIC_MIPI_CLK_POLAR
    int "MIPI clk polarities"
    default 0
    depends on AIC_DISP_MIPI_DSI_DRV

config AIC_MIPI_LANE_POLARITIES
    int "MIPI lane polarities"
    default 0
    depends on AIC_DISP_MIPI_DSI_DRV

endmenu
```

## bsp/zx/drv/display/panel/Kconfig
```kconfig
menu "Display Panels"

    choice
        prompt "ZX Panel Drivers"
        default AIC_SIMPLE_PANEL

    config AIC_SIMPLE_PANEL
        bool "ZX simple panel"
        depends on AIC_DISP_RGB || AIC_DISP_LVDS

    config AIC_PANEL_DSI_XM91080
        bool "ZX MIPI DSI xm91080 panel"
        depends on AIC_DISP_MIPI_DSI

    config AIC_PANEL_DSI_GV9503
	bool "ZX MIPI DSI gv9503 panel"
	depends on AIC_DISP_MIPI_DSI

    config AIC_PANEL_DSI_FL7705N
        bool "ZX MIPI DSI fl7705n panel"
        depends on AIC_DISP_MIPI_DSI

    config AIC_PANEL_DSI_ICNL9707
        bool "ZX MIPI DSI icnl9707 panel"
        depends on AIC_DISP_MIPI_DSI

    config AIC_PANEL_DSI_JD9365DA
        bool "ZX MIPI DSI jd9365da panel"
        depends on AIC_DISP_MIPI_DSI

    config AIC_PANEL_DSI_EK79007AD
        bool "ZX MIPI DSI ek79007ad panel"
        depends on AIC_DISP_MIPI_DSI

    config AIC_PANEL_DBI_ST7789V
        bool "ZX MIPI DBI st7789v panel"
        depends on AIC_DISP_MIPI_DBI

    config AIC_PANEL_DBI_ILI9488
        bool "ZX MIPI DBI SPI ili9488 panel"
        depends on AIC_DISP_MIPI_DBI

    config AIC_PANEL_DBI_ILI9341
        bool "ZX MIPI DBI SPI ili9341 panel"
        depends on AIC_DISP_MIPI_DBI

    config AIC_PANEL_DBI_ST77903
        bool "ZX MIPI DBI SPI st77903 panel"
        depends on AIC_DISP_MIPI_DBI

    config AIC_PANEL_DBI_ILI9486L
        bool "ZX MIPI DBI ili9486l panel"
        depends on AIC_DISP_MIPI_DBI

    config AIC_PANEL_SRGB_HX8238
        bool "ZX srgb hx8238 panel"
        depends on AIC_DISP_RGB

    config AIC_PANEL_RGB_ST7701
        bool "ZX prgb st7701 panel"
        depends on AIC_DISP_RGB

    endchoice

if AIC_SIMPLE_PANEL && !AIC_DISP_PQ_TOOL
source "bsp/zx/drv/display/panel/Kconfig.timing"
endif

if AIC_PANEL_RGB_ST7701
source "bsp/zx/drv/display/panel/Kconfig.st7701"
endif


endmenu
```

## bsp/zx/drv/display/panel/Kconfig.st7701
```kconfig
menu "st7701 spi"
    config PANEL_ST7701_RESET_GPIO
        string "ST7701 SPI reset"
        default ""

    config PANEL_ST7701_CS_GPIO
        string "ST7701 SPI CS"
        default ""

    config PANEL_ST7701_SCK_GPIO
        string "ST7701 SPI SCK"
        default ""

    config PANEL_ST7701_SDA_GPIO
        string "ST7701 SPI SDA"
        default ""

endmenu
```

## bsp/zx/drv/efuse/Kconfig.dev
```kconfig
#-----------------------------
# eFuse/SID devices local parameter
#-----------------------------
menu "SID Parameter"
    depends on AIC_USING_SID

    config EFUSE_MAX_WORD
	int "set efuse max word"
	default 64

    config EFUSE_TIMING_VALUE
	hex "set timing value"
	default 0x0402FFD8 if AIC_CHIP_M3C
	default 0x0402FFD8 if AIC_CHIP_M3A
	default 0x0402FFD8 if AIC_CHIP_M3
	default 0x04021FF1 if AIC_CHIP_M4
endmenu
```

## packages/Kconfig
```kconfig
menu "Local packages options"

source "packages/third-party/Kconfig"
source "packages/zx/Kconfig"

endmenu
```

## packages/third-party/blobmsg/Kconfig
```kconfig
# Kconfig file for package ramdisk
menuconfig LPKG_USING_BLOBMSG
    bool "blogmsg: openwrt blobmsg."
    default n
```

## packages/third-party/cJSON/Kconfig
```kconfig
# Kconfig file for package cjson
menuconfig LPKG_USING_CJSON
    bool "cjson."
    default n
```

## packages/third-party/freetype/Kconfig
```kconfig
# Kconfig file for package littlefs
menuconfig LPKG_USING_FREETYPE
    bool "Freetype: 2.13.1"
    default n
```

## packages/third-party/lvgl/Kconfig
```kconfig
# Kconfig file for package LVGL
menuconfig LPKG_USING_LVGL
    bool "LVGL (official): powerful and easy-to-use embedded GUI library"
    default n

if LPKG_USING_LVGL

    config LPKG_LVGL_PATH
        string
        default "/packages/multimedia/LVGL/LVGL"

    config LPKG_LVGL_THREAD_PRIO
        int "Priority of LVGL thread"
        default 20

    config LPKG_LVGL_THREAD_STACK_SIZE
        int "Stack size of LVGL thread"
        default 4096

    config LPKG_LVGL_DISP_REFR_PERIOD
        int "Display refresh period (ms)"
        default 5 # official suggestion

    config LPKG_USING_LVGL_SQUARELINE
        bool "Support SquareLine Studio"
        default n

    config LPKG_LVGL_USING_EXAMPLES
        bool "Enable built-in examples"
        default n

    config LPKG_LVGL_USING_DEMOS
        bool "Enable built-in demos"
        default n

    config LV_COLOR_DEPTH
        int "lvgl color depth(32/16)"
        default 32

    config CACHE_IMG_NUM
        int "image cached number"
        default 15

endif
```

## packages/third-party/lzma/Kconfig
```kconfig
# Kconfig file for package lzma
menuconfig PKG_USING_LZMA
    bool "LZMA: A compression library with high compression ratio"
    default n
    help
       LZMA is a compression library with high compression ratio
```

## packages/third-party/mini_gzip/Kconfig
```kconfig
# Kconfig file for package mini_gzip
menuconfig PKG_USING_MINIGZIP
    bool "mini_gzip:a simple memory gzip"
    default n
```

## packages/third-party/zx_button/Kconfig
```kconfig
# Kconfig file for package ramdisk
menuconfig LPKG_USING_ZX_BUTTON
    bool "zx button: adc/gpio button."
    default n

if LPKG_USING_ZX_BUTTON
    menuconfig PKG_USING_ZX_ADC_BUTTON
        bool "ADC mode: adc button."
        default n
        if PKG_USING_ZX_ADC_BUTTON
            config ADC_BTN_CHANNEL
                int "set adc channel"
                range 0 7
                default 7
        endif

    menuconfig PKG_USING_ZX_GPIO_BUTTON
        bool "GPIO mode: gpio button."
        default n
        if PKG_USING_ZX_GPIO_BUTTON
            config GPIO_BTN_PIN_NAME
                string "set gpio pin"
                default "PD.15"
            config GPIO_BTN_NAME
                string "set gpio btn name"
                default "key1"
            config GPIO_BTN_MODE
                int "Select GPIO mode"
                range 0 2
                default 1
            config GPIO_BTN_ACTIVE_LEVEL
                int "set active level(The level at which the key is pressed)"
                range 0 1
                default 0
        endif
endif
```

## packages/zx/Kconfig
```kconfig
menu "ZX packages options"

source "packages/zx/mpp/Kconfig"
source "packages/zx/env/Kconfig"
source "packages/zx/pinmux-check/Kconfig"
source "packages/zx/ota/Kconfig"

endmenu
```
